/*
 * Copyright (c) 2023 The ZMK Contributors
 *
 * SPDX-License-Identifier: MIT
 * 
 * Pin mappings for nice60 with 8 columns x 4 rows
 * Place this file at: config/boards/shields/nice60/boards/nice_nano_v2.overlay
 */

/ {
    kscan0: kscan_0 {
        compatible = "zmk,kscan-gpio-matrix";
        diode-direction = "col2row";
        wakeup-source;

        // Column pins (outputs) - 8 columns
        col-gpios
            = <&gpio0 31 GPIO_ACTIVE_HIGH>  // Col 0 - P0.31
            , <&gpio0 29 GPIO_ACTIVE_HIGH>  // Col 1 - P0.29
            , <&gpio0 2  GPIO_ACTIVE_HIGH>  // Col 2 - P0.02
            , <&gpio1 15 GPIO_ACTIVE_HIGH>  // Col 3 - P1.15
            , <&gpio1 13 GPIO_ACTIVE_HIGH>  // Col 4 - P1.13
            , <&gpio1 11 GPIO_ACTIVE_HIGH>  // Col 5 - P1.11
            , <&gpio0 10 GPIO_ACTIVE_HIGH>  // Col 6 - P0.10
            , <&gpio0 6  GPIO_ACTIVE_HIGH>  // Col 7 - P0.06
            ;

        // Row pins (inputs with pull-down) - 4 rows
        row-gpios
            = <&gpio0 11 (GPIO_ACTIVE_HIGH | GPIO_PULL_DOWN)>  // Row 0 - P0.11
            , <&gpio1 4  (GPIO_ACTIVE_HIGH | GPIO_PULL_DOWN)>  // Row 1 - P1.04
            , <&gpio1 6  (GPIO_ACTIVE_HIGH | GPIO_PULL_DOWN)>  // Row 2 - P1.06
            , <&gpio0 9  (GPIO_ACTIVE_HIGH | GPIO_PULL_DOWN)>  // Row 3 - P0.09
            ;
    };
};