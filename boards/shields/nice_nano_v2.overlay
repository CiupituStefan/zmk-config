/*
 * Copyright (c) 2023 The ZMK Contributors
 *
 * SPDX-License-Identifier: MIT
 * 
 * This file contains the pin mappings for nice60 when used with nice_nano_v2
 * Place this file at: config/boards/nice_nano_v2.overlay
 */

/ {
    kscan0: kscan_0 {
        compatible = "zmk,kscan-gpio-matrix";
        diode-direction = "row2col";
        wakeup-source;

        // Column pins (outputs) - 14 columns using actual nRF52840 pin names
        col-gpios
            = <&gpio0 31 GPIO_ACTIVE_HIGH>  // Col 0  - P0.31
            , <&gpio0 29 GPIO_ACTIVE_HIGH>  // Col 1  - P0.29
            , <&gpio0 2  GPIO_ACTIVE_HIGH>  // Col 2  - P0.02
            , <&gpio1 15 GPIO_ACTIVE_HIGH>  // Col 3  - P1.15
            , <&gpio1 13 GPIO_ACTIVE_HIGH>  // Col 4  - P1.13
            , <&gpio1 11 GPIO_ACTIVE_HIGH>  // Col 5  - P1.11
            , <&gpio0 10 GPIO_ACTIVE_HIGH>  // Col 6  - P0.10
            , <&gpio0 6  GPIO_ACTIVE_HIGH>  // Col 7  - P0.06
            , <&gpio0 8  GPIO_ACTIVE_HIGH>  // Col 8  - P0.08
            , <&gpio0 17 GPIO_ACTIVE_HIGH>  // Col 9  - P0.17
            , <&gpio0 20 GPIO_ACTIVE_HIGH>  // Col 10 - P0.20
            , <&gpio0 22 GPIO_ACTIVE_HIGH>  // Col 11 - P0.22
            , <&gpio0 4 GPIO_ACTIVE_HIGH>  // Col 12 - P0.24
            , <&gpio1 0  GPIO_ACTIVE_HIGH>  // Col 13 - P1.00
            ;

        // Row pins (inputs with pull-down) - 5 rows
        row-gpios
            = <&gpio0 11 (GPIO_ACTIVE_HIGH | GPIO_PULL_DOWN)>  // Row 0 - P0.11
            , <&gpio1 4  (GPIO_ACTIVE_HIGH | GPIO_PULL_DOWN)>  // Row 1 - P1.04
            , <&gpio1 6  (GPIO_ACTIVE_HIGH | GPIO_PULL_DOWN)>  // Row 2 - P1.06
            , <&gpio0 9  (GPIO_ACTIVE_HIGH | GPIO_PULL_DOWN)>  // Row 3 - P0.09
            , <&gpio0 12 (GPIO_ACTIVE_HIGH | GPIO_PULL_DOWN)>  // Row 4 - P0.12
            ;
    };
};